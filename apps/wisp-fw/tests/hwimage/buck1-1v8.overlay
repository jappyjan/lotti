/* SPDX-License-Identifier: MIT
 * TEST ONLY (scripts/test.sh): native-1 with BUCK1's switch expecting the A6N-G's code 0x08
 * (1.8 V) instead of W21's 0x01; the hardware-image gate must refuse it. */
&wisp_buck1 {
	expect-vout = <0x08>;
};
